////////////////////////////////////////////////////////////////////////////////
//
//  File:  ti_51ew_cc2533f96_oad.xcl
//
//  Description:
//    This is an extended command line file for IAR XLINK tool to be used when
//    linking applications written for the TI CC2533F96 (6 kB RAM/96 kB flash)
//    and an image that occupies only half of available flash for OAD use.
//
//  Important:
//    Data cannot be located at address zero, this address is reserved for
//    the null pointer.
//
////////////////////////////////////////////////////////////////////////////////



////////////////////////////////////////////////////////////////////////////////
//
//
// Segment limits
// --------------
//
//
// XDATA available to the program.
//
// Reserving address 0x0 for NULL.
-D_XDATA_START=0x0001
-D_XDATA_END=0x16FF
//
//
// The 8052 IDATA is overlayed on the SoC XDATA space from 0x1700-0x17FF.
//
-D_IDATA_END=0xFF              // Last address of Idata memory.
//
//
//    CODE
//
-D_OAD_HEADER=0x100
-D_OAD_BOOT_SIZE=0x800
-D_CODE_START=(_OAD_BOOT_SIZE+_OAD_HEADER)
//_CODE_END=0xBBFF  // Address range for HAL_FLASH_PAGE_SIZE == 1024
-D_CODE_END=0xB7FF  // Address range for HAL_FLASH_PAGE_SIZE == 2048
//
//
//
// Special SFRs
// ------------
//
//    Register bank setup
//
-D?REGISTER_BANK=0             // Default register bank (0,1,2,3).
-D_REGISTER_BANK_START=0       // Start address for default register bank (00,08,10,18).
//
//
//    PDATA page setup
//    ----------------
-D?PBANK_NUMBER=0x16           // High byte of 16-bit address to the PDATA area.
//
//
//    Virtual register setup
//    ----------------------
//
-D_BREG_START=0x00             // The bit address where the BREG segments starts.
                               // Must be placed on: _BREG_START%8=0 where _BREG_START <= 0x78.
-D?VB=0x20                     // ?VB is used when referencing BREG as whole byte.
                               // Must be placed on: ?VB=0x20+_BREG_START/8.
//
////////////////////////////////////////////////////////////////////////////////



////////////////////////////////////////////////////////////////////////////////
//
// IDATA memory
//

// Setup "bit" segments (only for '__no_init bool' variables).
-Z(BIT)BREG=_BREG_START
-Z(BIT)BIT_N=0-7F

-Z(DATA)REGISTERS+8=_REGISTER_BANK_START
-Z(DATA)BDATA_Z,BDATA_N,BDATA_I=20-2F
-Z(DATA)VREG+_NR_OF_VIRTUAL_REGISTERS=08-7F
-Z(DATA)PSP,XSP=08-7F
-Z(DATA)DOVERLAY=08-7F
-Z(DATA)DATA_I,DATA_Z,DATA_N=08-7F

-U(IDATA)0-7F=(DATA)0-7F
-Z(IDATA)IDATA_I,IDATA_Z,IDATA_N=08-_IDATA_END
-Z(IDATA)ISTACK+_IDATA_STACK_SIZE#08-_IDATA_END
-Z(IDATA)IOVERLAY=08-FF

////////////////////////////////////////////////////////////////////////////////
//
// ROM memory
//
//
//
// Program memory
//
//-Z(CODE)INTVEC=0
-Z(CODE)INTVEC=0x800
-P(CODE)CSTART=_CODE_START-_CODE_END
-P(CODE)RCODE=_CODE_START-_CODE_END
-P(CODE)NEAR_CODE=_CODE_START-_CODE_END
//
// Initializers
//
-Z(CODE)BIT_ID,BDATA_ID,DATA_ID,IDATA_ID,IXDATA_ID,PDATA_ID,XDATA_ID=_CODE_START-_CODE_END

//
// Constants located in code memory
//
-Z(CODE)CODE_C=_CODE_START-_CODE_END

-Z(CODE)PREAMBLE=(_OAD_BOOT_SIZE+0xC0)   // set preamble to begin after interrupt vectors

////////////////////////////////////////////////////////////////////////////////
//
// XDATA memory
//

-Z(XDATA)XSTACK+_XDATA_STACK_SIZE=_XDATA_START-_XDATA_END
-Z(XDATA)XDATA_Z,XDATA_I,PDATA_Z=_XDATA_START-_XDATA_END
-P(XDATA)XDATA_N=_XDATA_START-_XDATA_END

-cx51

////////////////////////////////////////////////////////////////////////////////
//
// Texas Instruments device specific
// =================================
//
//
// Setup of PM0 XDATA
// The set up of PM0 XDATA is required for reused legacy code
// ------------------
//
-D_PM0_XDATA_START=_XDATA_START
-D_PM0_XDATA_END=_XDATA_END
//
-Z(XDATA)PM0_XDATA=_PM0_XDATA_START-_PM0_XDATA_END
//
//
-Z(CODE)ALIGNED_CODE|2=_CODE_START-_CODE_END
//
////////////////////////////////////////////////////////////////////////////////
